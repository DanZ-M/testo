/* ========================================
FileName: corne.keymap
Date: 15:17 23.September.2022
Author: Marcos Chow Castro
Email: mctechnology170318@gmail.com
GitHub: https://github.com/mctechnology17
Brief: keymap for the wireless corne keyboard
                             ╔═╦═╦═╗
                      ╔════╗ ║║║║║╔╝
                      ║╔╗╔╗║ ║║║║║╚╗
                      ╚╝║║╚╝ ║╠═╩╩═╝
                        ║╠═╦═╣╚╦═╦╦═╦╗╔═╦═╦╦╗
                        ║║╩╣═╣║║║║║╬║╚╣╬║╬║║║
                        ╚╩═╩═╩╩╩╩═╩═╩═╩═╬╗╠╗║
                                        ╚═╩═╝
Copyright (c) 2020 The ZMK Contributors
SPDX-License-Identifier: MIT
========================================= */
// ### include {{{
#include <behaviors.dtsi>
#include <dt-bindings/zmk/keys.h>
#include <dt-bindings/zmk/bt.h>
#include <dt-bindings/zmk/outputs.h>
#include <dt-bindings/zmk/ext_power.h>

// }}}
// ### ifdef CONFIG_ZMK_RGB_UNDERGLOW {{{
// #    include <dt-bindings/led/led.h>
// #    include <../boards/shields/corne/boards/nice_nano.overlay>
#ifdef CONFIG_ZMK_RGB_UNDERGLOW
#    include <dt-bindings/zmk/rgb.h>
#endif // CONFIG_ZMK_RGB_UNDERGLOW
//}}}
// ### define {{{
#define DEFAULT 0
#define NUMB   1
#define RAISE   2
#define MOC   3
#define MEDIA 4
#define MOUSE 5
#define NONE 0
// combinadas para optimizar espacio
#define MEDIA_ESC &lt MEDIA ESC
#define MOUSE_TAB &lt MOUSE TAB
#define NUMBER_SPACE &lt NUMBER SPACE
#define SYMBOL_RGUI &lt SYMBOL RGUI
#define FUNCTION_RALT &lt FUNCTION RALT
// default_layer
#define LSHFT_COMMA &mt LSHFT COMMA
// function_layer
#define SPELL &kp LC(LG(D))
#define TRADUCT &kp LS(LA(T))
#define SNIPPET &kp LA(LG(G))
#define CLIPBRD &kp LA(LG(V))
#define EMOJI &kp LC(LG(SPACE))
#define TASKM &kp LC(LA(DEL)) // C-A-DEL

//}}}
// ### macros {{{
#define MACRO(name, keys)           \
name: name##_macro {                \
	label = #name;                    \
	compatible = "zmk,behavior-macro";\
	#binding-cells = <0>;             \
	tap-ms = <1>;                     \
	wait-ms = <1>;                    \
	bindings = <keys>;                \
};

/ {
	macros {
		MACRO(example, &kp LS(H) &kp E &kp L &kp L &kp O)
		MACRO(mctechnology, &kp M &kp C &kp T &kp E &kp C &kp H &kp N &kp O &kp L &kp O &kp G &kp Y &kp N1 &kp N7)
		MACRO(linea, DE_END &kp LS(HOME) DE_BSPC)
MACRO(pass,  &macro_press &kp LSHFT &macro_tap &kp M &macro_release &kp LSHFT &macro_tap &kp Z &kp SPACE &macro_press &kp LALT  &macro_tap   &kp KP_N1 &kp KP_N6 &kp KP_N5 &macro_release  &kp LALT     &macro_tap   &kp SPACE &kp KP_N1 &kp KP_N3 &kp SPACE &kp KP_N2 &kp KP_N4 &kp SPACE &kp DOLLAR   &macro_tap_time 500  &kp RET)
		MACRO(DQT_q,  &kp DQT &kp DQT &kp LEFT)
		MACRO(PAR_s,  &macro_tap &kp LPAR &kp RPAR &kp LEFT)
		MACRO(SNC_up, &macro_press &kp LSHFT &macro_tap &kp S &kp N &kp C &macro_release &kp LSHFT &macro_tap &kp HASH)	
	};
};

   
 
/////////////////////////////
/ {

    combos {
        compatible = "zmk,combos";
	combo_MINUS {
            timeout-ms = <90>;
            key-positions = <31 39>;
            bindings = <&kp MINUS>;
        };
	combo_UNDER {
            timeout-ms = <90>;
            key-positions = <19 39>;
            bindings = <&kp UNDER>;
        };
	combo_DEL {
            timeout-ms = <90>;
            key-positions = <10 11>;
            bindings = <&kp DEL>;
        };
	combo_SHDEL {
            timeout-ms = <90>;
            key-positions = <10 11>;
            bindings = <&kp RS(DEL)>;
        };
	combo_AT {
            timeout-ms = <90>;
            key-positions = <16 1>;
            bindings = <&kp AT>;
        };
        combo_DLLR {
            timeout-ms = <90>;
            key-positions = <16 14>;
            bindings = <&kp DLLR>;
        };
        combo_AMPS {
            timeout-ms = <90>;
            key-positions = <16 13>;
            bindings = <&kp AMPS>;
        };

        combo_PASTE {
            timeout-ms = <90>;
            key-positions = <19 40>;
            bindings = <&kp LC(V)>;
        };

        combo_COPY {
            timeout-ms = <90>;
            key-positions = <19 41>;
            bindings = <&kp LC(C)>;
        };

        combo_DQT {
            timeout-ms = <150>;
            key-positions = <29 30>;
            bindings = <&DQT_q>;
        };

        combo_PAR {
            timeout-ms = <150>;
            key-positions = <28 31>;
            bindings = <&PAR_s>;
        };

        combo_SNC {
            timeout-ms = <150>;
            key-positions = <5 6>;
            bindings = <&SNC_up>;
        };
    };
};

//////////////////////////////

/ {
    keymap {
                compatible = "zmk,keymap";
                default_layer {
                        bindings = <
// _______________________________________________________________________         ________________________________________________________________________ 
// |      ESC    |     Q    |     W    |     E    |     R    |     T     |         |    Y     |    U     |     I    |    O     |     P     |     BKSP     ||
       &kp ESC      &kp Q      &kp W       &kp E      &kp R      &kp T                &kp Y       &kp U      &kp I       &kp O     &kp P       &kp BSPC
// __position 0__|_____1____|_____2____|_____3____|_____4____|_____5_____|         |_____6____|_____7____|_____8____|_____9____|_____10____|______11______|| 
// |     TAB     |     A    |     S    |     D    |     F    |     G     |         |    H     |     J    |    K     |    L     |     ;     |   RSHIFT / ' ||
      &kp TAB       &kp A      &kp S      &kp D       &kp F      &kp G                 &kp H  &pht RCTRL J    &kp K       &kp L    &kp SEMI    &hm RSHIFT SQT
// |______12_____|____13____|____14____|____15____|____16____|____17_____|         |____18____|____19____|____20____|____21____|_____22____|______23______||   
// |     CTRL    |    Z     |    X     |    C     |     V    |     B     |         | Layer1/N |     M    |     ,    |    .     |     /     |     ENTER    || 
      &kp LCTRL     &kp Z       &kp X      &kp C      &kp V      &kp B               &lt 3 N     &kp M    &kp COMMA   &kp DOT    &kp FSLH      &kp RET
// _______24_____|____25____|____26____|____27____|____28____|_____29____|         |_____30___|____31____|____32____|____33____|_____34____|______35______||                   
//                             |  CAPS/SHFT   |    ALT    |    ENTER    |           |   ENT/ALT   |   LAYER2   |   LAYER1    |
                               &mt LSHIFT CAPS   &kp LALT    &kp RET                 &mt RALT SPACE     &mo 2   &pht mo 1 tog NUMB
//                             |______36______|_____37____|______38_____|           |______39_____|_____40_____|______41_____|                    
                        >;
                };
                numb_layer {
                        bindings = <                
// _______________________________________________________________________________         _______________________________________________________________________________
// |    ESC    |     BT0    |     BT1     | ext_power |     3      |    EQUAL     |         |     /      |      7      |     8      |     9     |     -     |     BKSP   ||                       
     &kp ESC    &bt BT_SEL 0  &bt BT_SEL 1 &ext_power EP_TOG &kp N3  &kp EQUAL             &kp FSLH     &kp KP_N7    &kp KP_N8    &kp KP_N9   &kp MINUS    &kp BSPC
// ____________|____________|_____________|___________|___________|______________|         |____________|_____________|____________|___________|___________|____________|| 
// |    TAB    |    BT2     |     BT3     | OUT_USB   |    F      |              |         |    *       |      4      |     5      |     6     |     +     | S-LAYER 1  || 
       &trans  &bt BT_SEL 2 &bt BT_SEL 3  &out OUT_USB   &trans       &trans                 &kp STAR      &kp KP_N4     &kp KP_N5   &kp KP_N6   &kp PLUS     &sl NUMB
// |___________|____________|_____________|___________|___________|______________|         |____________|_____________|____________|___________|___________|____________|| 
// |    CTRL   |    BT4     |   OUT_TOG   |  OUT_BLE  |   BT_CLR  |   NUM LOCK   |         |      0     |       1     |      2     |      3    |     .     |    ENTER   ||   
     &kp LSHFT  &bt BT_SEL 4 &out OUT_TOG  &out OUT_BLE  &bt BT_CLR  &kp KP_NLCK             &kp KP_N0     &kp KP_N1     &kp KP_N2   &kp KP_N3    &kp DOT      &trans
// |___________|____________|_____________|___________|___________|______________|         |____________|_____________|____________|___________|___________|____________||            
//                                       |  CAPS/SHFT |    ALT    |   ENTER    |            |   ENT/ALT   |   LAYER2   |      ,      |   
                          	           &kp LGUI      &trans      &kp RET                    &trans        &trans      &kp COMMA
//                                       |____________|___________|____________|            |_____________|____________|_____________|                                                     
                        >;
                };
                raise_layer {
                        bindings = <                        
// ________________________________________________________________________________         _________________________________________________________________________ 
// |      ESC    |       Q      |        W      |     E    |     R    |     T     |         |    Y     |     U     |     I    |    O      | BEGI DOC  |     BKSP     ||                        
      &kp  TAB   &rgb_ug RGB_BRI     &kp AT       &kp HASH   &kp DLLR   &kp PRCNT            &kp CARET   &kp AMPS    &kp STAR    &kp LPAR   &kp BG_DOC     &kp BSPC
// ______________|______________|_______________|__________|__________|___________|         |__________|___________|__________|___________|___________|______________|| 
// |     CTRL    |       A      |        S      |     D    |     F    |     G     |         |    H     | PREV WORD |    UP    | Next Word |   RSHIFT   |   RSHIFT / ' ||   
      &kp LCTRL  &rgb_ug RGB_EFF       &trans      &trans      &trans    &trans              &kp MINUS  &kp PRV_WD    &kp UP   &kp NXT_WD   &kp RSHIFT      &tog 2
// |_____________|______________|________&______|__________|__________|___________|         |__________|___________|__________|___________|___________|______________||   
// |     CTRL    |       Z      |      X        |    C     |     V    |     B     |         |     _    |      M    |    DOWN  |   RIGHT   | END DOCUM |     ENTER    ||    
      &kp LSHFT  &rgb_ug RGB_TOG &rgb_ug RGB_BRD   &trans     &trans      &trans             &kp UNDER   &kp LEFT    &kp DOWN   &kp RIGHT   &kp ED_DOC    &kp TILDE
// ______________|______________|_______________|__________|__________|___________|         |__________|___________|__________|___________|___________|______________||                   
//                                       |  CAPS/SHFT   |    ALT    |   ENTER    |            |   ENT/ALT   |   LAYER2   |   LAYER1    |   
                    	                     &kp LGUI       &trans    &kp SPACE                 &kp RET         &trans     &kp RALT
//                                       |______________|___________|____________|            |_____________|____________|_____________|                                                 
                        >;
                };
                moc_layer {
                        bindings = <
// _______________________________________________________________________         ________________________________________________________________________ 
// |      ESC    |     Q    |     W    |     E    |     R    |     T     |         |    Y     |    U     |     I    |    O     |     P     |     BKSP     ||                        
      &kp  TAB     &kp EXCL    &kp AT    &kp HASH   &kp DLLR   &kp PRCNT             &kp CARET &kp AMPS &kp KP_MULTIPLY &kp LPAR  &kp RPAR     &kp BSPC
// ______________|__________|__________|__________|__________|___________|         |__________|__________|__________|__________|___________|______________|| 
// |     CTRL    |     A    |     S    |     D    |     F    |     G     |         |    H     |     J    |    K     |    L     |     ;     |   RSHIFT / ' ||   
      &kp LCTRL      &trans    &trans      &trans      &trans    &trans           &kp MINUS    &kp PRV_WD   &kp UP   &kp NXT_WD  &kp BSLH      &to 3
// |_____________|__________|__________|__________|__________|___________|         |__________|__________|__________|__________|___________|______________||   
// |     CTRL    |    Z     |    X     |    C     |     V    |     B     |         | Layer1/N |     M    |     ,    |    .     |     /     |     ENTER    ||    
      &kp LSHFT     &trans     &trans      &pass      &trans    &trans                 &trans   &kp LEFT   &kp DOWN   &kp RIGHT   &trans       &kp TILDE
// ______________|__________|__________|__________|__________|___________|         |__________|__________|__________|__________|___________|______________||                   
//                             |  CAPS/SHFT   |    ALT    |   ENTER    |            |   ENT/ALT   |   LAYER2   |   LAYER1    |   
                    	            &kp LGUI       &trans    &kp SPACE                 &kp RET         &trans     &kp RALT
//                             |______________|___________|____________|            |_____________|____________|_____________|                                                 
                        >;
                };
              // }}}
      // ### media_layer {{{
      media_layer {
         // .------------------------------------------------.                         .-------------------------------------------------.
         // |        |SC_FLOW|TXTSNIP|SC_SHOT|OP_TERM|       |                         |POS1   |POS2   |LANG_1 |LANG_2 | STOP  |  DELETE |
         // |--------+-------+-------+-------+-------+-------|                         |-------+-------+-------+-------+-------+---------|
         // |        |SC_SPSF|SC_RE  |       |       |       |                         |POS3   |POS4   |LANG_3 |SHUFFLE|VOL_UP |PLAY/PAUS|
         // |--------+-------+-------+-------+-------+-------|                         |-------+-------+-------+-------+-------+---------|
         // |        |       |       |       |       |       |                         |       |       |  MUTE |  PREV |VOL_DOW|  NEXT   |
         // '---------------------------------------------------------|       |----------------------------------------------------------'
         //                          |  CTRL    |  CMD       |   ALT  |       |  SPACE | ALTGR |          CTRL |
         //                          '--------------------------------'       '--------------------------------'
         // label = "MEDIA";
         bindings = <
            XXX  SC_FLOW  TXTSNIP  SC_SHOT OP_TERM   XXX                         POS1  POS2  DE_LANG1  DE_LANG2    DE_STOP    DE_DEL
            XXX  SC_SPSF  SC_RE    XXX     XXX       XXX                         POS3  POS4  DE_LANG3  DE_SHUFFLE  DE_VOL_UP  DE_PLAY
            XXX  XXX      XXX      XXX     XXX       XXX                         XXX   XXX   DE_MUTE   DE_PREV     DE_VOL_DN  DE_NEXT
                                           DE_LCTRL  DE_LGUI  DE_LALT  DE_SPACE  DE_RALT DE_LCTRL
                                 >;
                         };
      // }}}
#ifdef CONFIG_ZMK_RGB_UNDERGLOW
      // ### mouse_layer {{{
      mouse_layer {
         //   .------------------------------------------------.                         .-------------------------------------------------.
         //   |        |       |       |OUT_USB|OUT_BLE|OUT_TOG|                         |RGBBRI-|RGBBRI+|WH_LEFT|WH_RIGH|WH_DOWN| WH_UP   |
         //   |--------+-------+-------+-------+-------+-------|                         |-------+-------+-------+-------+-------+---------|
         //   |        |CLICK_1|CLICK_2|CLICK_3|BT_PRV | BT_NXT|                         |RGBSAT-|RGBSAT+|       |CLICK_1| UP    |CLICK_2  |
         //   |--------+-------+-------+-------+-------+-------|                         |-------+-------+-------+-------+-------+---------|
         //   |BT_CLR  |BT_0   |BT_1   |BT_2   |BT_3   |BT_4   |                         |RGBHUE-|RGBHUE+| RESET | LEFT  | DOWN  | RIGHT   |
         //   '---------------------------------------------------------|       |----------------------------------------------------------'
         //                            |EP_OFF  | EP_ON|         EP_TOG |       |RGBANI- |RGBANI+|   RGBTOG      |
         //                            '--------------------------------'       '--------------------------------'
         // label = "MOUSE";
         // XXX XXX XXX &out OUT_USB &out OUT_BLE  &out OUT_TOG                                  &mwh SCROLL_HOR(-15) &mwh SCROLL_VERT(-15) &mwh SCROLL_VERT(15) &mwh SCROLL_HOR(15)  &mwh SCROLL_DOWN  &mwh SCROLL_UP
         // XXX &mkp LCLK &mkp RCLK &mkp MCLK &bt BT_PRV &bt BT_NXT                              &rgb_ug RGB_SAD    &rgb_ug RGB_SAI   XXX  XXX  &mmv MOVE_VERT(-2500)  XXX
         // &bt BT_CLR   &bt BT(0) &bt BT(1) &bt BT(2) &bt BT(3) &bt BT(4)                       &rgb_ug RGB_HUD    &rgb_ug RGB_HUI  &reset  &mmv MOVE_HOR(-2500) &mmv MOVE_VERT(2500) &mmv MOVE_HOR(2500)
         //                         &ext_power EP_OFF    &ext_power EP_ON   &ext_power EP_TOG    &rgb_ug RGB_EFR    &rgb_ug RGB_EFF  &rgb_ug RGB_TOG
         bindings = <
            XXX XXX XXX &out OUT_USB &out OUT_BLE  &out OUT_TOG                                  &rgb_ug RGB_BRD    &rgb_ug RGB_BRI   XXX  XXX  XXX  XXX
            XXX XXX XXX &bt BT_CLR &bt BT_PRV &bt BT_NXT                                         &rgb_ug RGB_SAD    &rgb_ug RGB_SAI   XXX  XXX  XXX  XXX
            &bt BT_CLR   &bt BT(0) &bt BT(1) &bt BT(2) &bt BT(3) &bt BT(4)                       &rgb_ug RGB_HUD    &rgb_ug RGB_HUI  &reset  XXX  XXX  XXX
                                    &ext_power EP_OFF    &ext_power EP_ON   &ext_power EP_TOG    &rgb_ug RGB_EFR    &rgb_ug RGB_EFF  &rgb_ug RGB_TOG
                                 >;
                         };
      // }}}
#else
      // ### mouse_layer {{{
      mouse_layer {
         //   .------------------------------------------------.                         .-------------------------------------------------.
         //   |        |       |       |OUT_USB|OUT_BLE|OUT_TOG|                         |       |       |WH_LEFT|WH_RIGH|WH_DOWN| WH_UP   |
         //   |--------+-------+-------+-------+-------+-------|                         |-------+-------+-------+-------+-------+---------|
         //   |        |CLICK_1|CLICK_2|CLICK_3|BT_PRV | BT_NXT|                         |       |       |       |CLICK_1| UP    |CLICK_2  |
         //   |--------+-------+-------+-------+-------+-------|                         |-------+-------+-------+-------+-------+---------|
         //   |BT_CLR  |BT_0   |BT_1   |BT_2   |BT_3   |BT_4   |                         |       |       | RESET | LEFT  | DOWN  | RIGHT   |
         //   '---------------------------------------------------------|       |----------------------------------------------------------'
         //                            |EP_OFF  | EP_ON|         EP_TOG |       |       |        |               |
         //                            '--------------------------------'       '--------------------------------'
         // label = "MOUSE";
         // XXX XXX XXX &out OUT_USB &out OUT_BLE  &out OUT_TOG                                  &mwh SCROLL_HOR(-15) &mwh SCROLL_VERT(-15) &mwh SCROLL_VERT(15) &mwh SCROLL_HOR(15)  &mwh SCROLL_DOWN  &mwh SCROLL_UP
         // XXX &mkp LCLK &mkp RCLK &mkp MCLK &bt BT_PRV &bt BT_NXT                              XXX  XXX XXX    XXX                  &mmv MOVE_VERT(-2500)   XXX
         // &bt BT_CLR   &bt BT(0) &bt BT(1) &bt BT(2) &bt BT(3) &bt BT(4)                       XXX  XXX &reset &mmv MOVE_HOR(-2500) &mmv MOVE_VERT(2500) &mmv MOVE_HOR(2500)
         //                         &ext_power EP_OFF    &ext_power EP_ON   &ext_power EP_TOG    XXX  XXX  XXX
         bindings = <
            XXX XXX XXX &out OUT_USB &out OUT_BLE  &out OUT_TOG                                  XXX  XXX XXX XXX  XXX XXX
            XXX XXX XXX XXX &bt BT_PRV &bt BT_NXT                                                XXX  XXX XXX XXX  XXX XXX
            &bt BT_CLR   &bt BT(0) &bt BT(1) &bt BT(2) &bt BT(3) &bt BT(4)                       XXX  XXX &reset XXX  XXX XXX
                                    &ext_power EP_OFF    &ext_power EP_ON   &ext_power EP_TOG    XXX  XXX  XXX
                                 >;
                         };
      // }}}
#endif // CONFIG_ZMK_RGB_UNDERGLOW
  }; 
        behaviors {
            hm: homerow_mods {
            compatible = "zmk,behavior-hold-tap";
            label = "HOMEROW_MODS";
            #binding-cells = <2>;
            tapping_term_ms = <150>;
            flavor = "tap-preferred";
            bindings =
                <&kp>,
                <&kp>;
        };
        pht: positional_hold_tap {
            compatible = "zmk,behavior-hold-tap";
            label = "POSITIONAL_HOLD_TAP";
            #binding-cells = <2>;
            flavor = "hold-preferred";
            tapping-term-ms = <400>;
            quick-tap-ms = <200>;
            bindings =
                <&kp>,
                <&kp>;

            hold-trigger-key-positions = <1>;// <---[[the J key]]
        };
    };
};



// }}}
// }}}
// vim: fdm=marker:
